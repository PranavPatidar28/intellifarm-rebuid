#include <WiFi.h>
#include <HTTPClient.h>
#include <ArduinoJson.h> // Make sure to install ArduinoJson (v7 recommended) via Library Manager
#include "DHT.h"

/* =========================
   WIFI & API CONFIG
========================= */
const char* ssid = "vivo V25 Pro";
const char* password = "wxyz@321";

// Replace YOUR_BACKEND_IP with your computer's local IP address (e.g., 192.168.1.5)
const char* apiEndpoint = "http://10.152.88.84:4000/v1/devices/ingest";

// You can generate a device key from the Intellifarm backend or use the one generated by seed.ts
const char* deviceKey = "demo-north-field-key"; 
const char* hardwareId = "north-field-sensor-01";

/* =========================
   PIN CONFIG (ESP32-CAM)
========================= */
// Note: ESP32-CAM does NOT expose any ADC1 pins.
// We MUST use the digital output of the soil sensor if Wi-Fi is active.
#define DHTPIN 13
#define DHTTYPE DHT11
#define SOIL_PIN 14  // Connect to DIGITAL out (D0) of the soil sensor
#define RELAY_PIN 15 // Connect to relay module

// Relay Logic (Most Arduino/ESP32 relay modules are Active-LOW)
#define RELAY_ON LOW
#define RELAY_OFF HIGH

/* =========================
   OBJECTS & STATE
========================= */
DHT dht(DHTPIN, DHTTYPE);

float temperature = 0;
float humidity = 0;
float soilMoisturePercent = 0;
String pumpState = "OFF";
String controlMode = "AUTO"; // AUTO, FORCE_ON, FORCE_OFF

unsigned long lastPostTime = 0;
const unsigned long postInterval = 1000; // Send data every 1 second

void setup() {
  Serial.begin(115200);

  // Initialize Pins
  pinMode(SOIL_PIN, INPUT);
  pinMode(RELAY_PIN, OUTPUT);
  digitalWrite(RELAY_PIN, RELAY_OFF); // Pump OFF by default

  // Initialize Sensors
  dht.begin();

  // Connect to Wi-Fi
  Serial.println();
  Serial.print("Connecting to WiFi: ");
  Serial.println(ssid);
  WiFi.begin(ssid, password);

  while (WiFi.status() != WL_CONNECTED) {
    delay(500);
    Serial.print(".");
  }

  Serial.println("\nWiFi Connected!");
  Serial.print("IP Address: ");
  Serial.println(WiFi.localIP());
}

void loop() {
  // ---------------------------------------------------------
  // 1. READ SENSORS
  // ---------------------------------------------------------
  float temp = dht.readTemperature();
  float hum = dht.readHumidity();
  
  if (!isnan(temp) && !isnan(hum)) {
    temperature = temp;
    humidity = hum;
  }

  // Read the DIGITAL output of the soil sensor
  int soilDigital = digitalRead(SOIL_PIN);
  
  // The API expects a moisture percentage (0-100).
  // We map the digital DRY/WET state to synthetic percentages.
  // Note: Tune the potentiometer on your soil sensor module to set the wet/dry threshold!
  if (soilDigital == LOW) { // Usually LOW means WET on digital modules
    soilMoisturePercent = 90.0; // WET
  } else {
    soilMoisturePercent = 10.0; // DRY
  }

  // ---------------------------------------------------------
  // 2. LOCAL CONTROL LOGIC
  // ---------------------------------------------------------
  if (controlMode == "FORCE_ON") {
    digitalWrite(RELAY_PIN, RELAY_ON);
    pumpState = "ON";
  } else if (controlMode == "FORCE_OFF") {
    digitalWrite(RELAY_PIN, RELAY_OFF);
    pumpState = "OFF";
  } else {
    // AUTO mode: Rely on digital soil moisture reading
    if (soilMoisturePercent < 30.0) { // DRY -> Turn pump ON
      digitalWrite(RELAY_PIN, RELAY_ON);
      pumpState = "ON";
    } else if (soilMoisturePercent > 60.0) { // WET -> Turn pump OFF
      digitalWrite(RELAY_PIN, RELAY_OFF);
      pumpState = "OFF";
    }
  }

  // ---------------------------------------------------------
  // 3. SEND TELEMETRY & RECEIVE COMMANDS
  // ---------------------------------------------------------
  if (millis() - lastPostTime > postInterval) {
    if (WiFi.status() == WL_CONNECTED) {
      HTTPClient http;
      http.begin(apiEndpoint);
      http.addHeader("Content-Type", "application/json");
      http.addHeader("x-device-key", deviceKey);

      // Create JSON payload
      // Using ArduinoJson v7 syntax (fallback to StaticJsonDocument<512> if using v6)
      JsonDocument doc;
      doc["hardwareId"] = hardwareId;
      doc["temperatureC"] = temperature;
      doc["humidityPercent"] = humidity;
      doc["soilMoisturePercent"] = soilMoisturePercent;
      doc["pumpState"] = pumpState;
      doc["pumpControlMode"] = controlMode;

      String payload;
      serializeJson(doc, payload);
      
      Serial.println("\n--- Sending Telemetry ---");
      Serial.println(payload);

      int httpResponseCode = http.POST(payload);

      if (httpResponseCode > 0) {
        String responseBody = http.getString();
        Serial.print("HTTP Code: ");
        Serial.println(httpResponseCode);
        Serial.println("Response: " + responseBody);

        // Parse Response to get pending commands
        JsonDocument respDoc;
        DeserializationError error = deserializeJson(respDoc, responseBody);
        
        if (!error && respDoc.containsKey("pendingCommand") && !respDoc["pendingCommand"].isNull()) {
           String targetMode = respDoc["pendingCommand"]["targetMode"].as<String>();
           
           if (targetMode == "AUTO" || targetMode == "FORCE_ON" || targetMode == "FORCE_OFF") {
             controlMode = targetMode;
             Serial.println(">>> Override Received! Mode updated to: " + controlMode);
           }
        }
      } else {
        Serial.print("Error sending POST, HTTP Code: ");
        Serial.println(httpResponseCode);
      }
      
      http.end();
    } else {
      Serial.println("WiFi Disconnected!");
    }
    
    lastPostTime = millis();
  }

  // Small delay to prevent tight loop CPU hogging
  delay(100); 
}
